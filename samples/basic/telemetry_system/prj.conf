## CMakeLists.txt
```
# SPDX-License-Identifier: Apache-2.0
cmake_minimum_required(VERSION 3.20.0)

# Find Zephyr
find_package(Zephyr REQUIRED HINTS $ENV{ZEPHYR_BASE})

# Declare project
project(telemetry_system)

target_include_directories(app PRIVATE
    .
    inc
    app
)

if(CONFIG_TELEMETRY_VARIABLE_LIST_FILE)
    target_compile_definitions(app PRIVATE 
        VARIABLE_LIST_FILE=${CONFIG_TELEMETRY_VARIABLE_LIST_FILE}
    )
endif()

# Add source files
target_sources(app PRIVATE 
    src/main.c
    src/command_parser.c
    src/registry.c
    src/telemetry.c
)
```

## Kconfig
```
# Source Zephyr's Kconfig
source "Kconfig.zephyr"

# Application-specific configuration
menu "Telemetry Module Configuration"

config TELEMETRY_ENABLE
	bool "Enable telemetry system"
	default y
	help
	  Enables the variable registry and telemetry tasks.

config TELEMETRY_INTERVAL_MS
	int "Telemetry sending interval (ms)"
	default 1000
	depends on TELEMETRY_ENABLE

config TELEMETRY_VARIABLE_LIST_FILE
	string "Path to variable list header"
	default "variable_list_example.h"
	help
	  Specify the path to the variable list header defining VAR_ENTRY macros.
	  Example: "variable_list_example.h"

endmenu
```

## prj.conf
```kconfig
CONFIG_SERIAL=y
CONFIG_UART_ASYNC_API=y
CONFIG_UART_INTERRUPT_DRIVEN=y
CONFIG_HEAP_MEM_POOL_SIZE=256
CONFIG_CBPRINTF_FP_SUPPORT=y

# Telemetry module config (default path points to app/my_vars.h)
CONFIG_TELEMETRY_ENABLE=y
CONFIG_TELEMETRY_INTERVAL_MS=1
CONFIG_TELEMETRY_VARIABLE_LIST_FILE="app/my_vars.h"

CONFIG_GPIO=y
```

## src/main.c
```c
#include <zephyr/kernel.h>
#include <zephyr/drivers/uart.h>
#include <zephyr/sys/printk.h>
#include <zephyr/drivers/gpio.h>
#include "communication_interface.h"
#include "registry.h"
#include "command_parser.h"
#include <math.h>

float temperature = 25.5f;
float pressure = 1013.2f;
float humidity = 49.3f;
float led0_status = 0.0f;
float led1_status = 0.0f;

static const struct gpio_dt_spec led0 = GPIO_DT_SPEC_GET(DT_ALIAS(led0), gpios);
static const struct gpio_dt_spec led1 = GPIO_DT_SPEC_GET(DT_ALIAS(led1), gpios);

static const struct device *uart = DEVICE_DT_GET(DT_CHOSEN(zephyr_console));
static void uart_receive_callback(const struct device *dev, void *user_data);
static void uart_send_data(const struct device *dev, const char *data, size_t len);

struct telemetry_comm_interface comm_interface;

static struct {
    char buffer[128];
    size_t index;
} rx_data;

static void uart_receive_callback(const struct device *dev, void *user_data)
{
    char c;
    while (uart_poll_in(dev, (unsigned char *)&c) == 0) {
        if (rx_data.index < sizeof(rx_data.buffer) - 1) {
            rx_data.buffer[rx_data.index++] = c;
            if (c == '\n') {
                rx_data.buffer[rx_data.index] = '\0'; // Null-terminate
                command_parser_process_data(&comm_interface, rx_data.buffer, rx_data.index);
                rx_data.index = 0; // Reset for next line
            }
        } else {
            // Buffer overflow, reset index
            rx_data.index = 0;
        }
    }
}

static void uart_send_data(const struct device *dev, const char *data, size_t len)
{
    (void)dev; // Unused parameter
    (void)len; // Unused parameter
    printk("%s", data);
}


void update_led(const struct gpio_dt_spec* led, float led_status)
{
    if (led_status > 0.5f) {
        gpio_pin_set_dt(led, 1);  // LED ON
    } else {
        gpio_pin_set_dt(led, 0);  // LED OFF
    }
}

int main(void)
{
    if (!device_is_ready(led0.port)) {
        printk("Error: LED device %s not ready\n", led0.port->name);
        return -1;
    }

    gpio_pin_configure_dt(&led0, GPIO_OUTPUT_INACTIVE);

    if (!device_is_ready(led1.port)) {
        printk("Error: LED device %s not ready\n", led1.port->name);
        return -1;
    }

    gpio_pin_configure_dt(&led1, GPIO_OUTPUT_INACTIVE);

    if (!device_is_ready(uart)) {
        printk("UART device not ready\n");
        return -1;
    }

    comm_interface.dev = (struct device *)uart;
    comm_interface.recv = uart_receive_callback;
    comm_interface.send = uart_send_data;

    uart_irq_callback_set(uart, comm_interface.recv);
    uart_irq_rx_enable(uart);
    register_telemetry_sender(&comm_interface);
    
    printk("Telemetry System Started. Waiting for data...\n");
    
    float time_step = 0.0f;
    
    while (1) {
        k_sleep(K_MSEC(1));
        
        time_step += 0.001f;
        
        temperature = 25.5f + 8.0f * sinf(time_step * 5.f);
        pressure = 25.2f + 15.0f * sinf(time_step * 10.f);
        humidity = 25.3f + 20.0f * sinf(time_step * 15.f);

        update_led(&led0, led0_status);
        update_led(&led1, led1_status);
    }

    return 0;
}
```

## inc/command_parser.h
```c
#ifndef COMMAND_PARSER_H
#define COMMAND_PARSER_H

#include "communication_interface.h"

#define CMD_MAX_LEN 128

typedef void (*command_process_fn)(struct telemetry_comm_interface *comm_interface, const char *data, size_t len);

void command_parser_process_data(struct telemetry_comm_interface *comm_interface, const char *data, size_t len);

void get_variable_names(struct telemetry_comm_interface *comm_interface, const char *data, size_t len);

void get_variable(struct telemetry_comm_interface *comm_interface, const char *data, size_t len);

void set_variable(struct telemetry_comm_interface *comm_interface, const char *data, size_t len);

#endif // COMMAND_PARSER_H
```

## inc/command_processor.h
```c
#ifndef COMMAND_PROCESSOR_H
#define COMMAND_PROCESSOR_H

#include <zephyr/kernel.h>
#include "command_parser.h"
#include "communication_interface.h"

#define CMD_QUEUE_LEN 10

void command_processor_init(void);

void command_processor_submit(struct telemetry_comm_interface *iface, const char *cmd, size_t len);

#endif // COMMAND_PROCESSOR_H
```

## inc/communication_interface.h
```c
#ifndef COMMUNICATION_INTERFACE_H
#define COMMUNICATION_INTERFACE_H

#include <zephyr/kernel.h>
#include <zephyr/device.h>
#include <stddef.h>

typedef void  (*comm_recv_fn)(const struct device *dev, void *user_data);
typedef void (*comm_send_fn)(const struct device *dev, const char *data, size_t len);

struct telemetry_comm_interface {
    struct device *dev;
    comm_recv_fn recv;
    comm_send_fn send;
};

struct registered_telemetry_senders_t {
    const struct telemetry_comm_interface* interfaces[4]; // Hard coded for now
    size_t count;
};

extern struct registered_telemetry_senders_t registered_telemetry_senders;

static inline void register_telemetry_sender(const struct telemetry_comm_interface *iface) {
    if (registered_telemetry_senders.count < 4) {
        registered_telemetry_senders.interfaces[registered_telemetry_senders.count++] = iface;
    }
}

#endif // COMMUNICATION_INTERFACE_H
```

## inc/registry.h
```c
#ifndef REGISTRY_H
#define REGISTRY_H

#include <zephyr/kernel.h>
#include <stddef.h>

#ifndef STRINGIFY
#define _STR(x) #x
#define STRINGIFY(x) _STR(x)
#endif

typedef struct {
    const char *name;
    float *ptr;
} var_entry;

/*
 * Variable list inclusion.
 * User defines VARIABLE_LIST_FILE (via CMake define forwarded from Kconfig)
 */
#if defined(VARIABLE_LIST_FILE)
    #define VAR_LIST_INCLUDE STRINGIFY(VARIABLE_LIST_FILE)
#else
    #error "You must define VARIABLE_LIST_FILE (use Kconfig or -DVARIABLE_LIST_FILE)!"
#endif

/* Generate enum IDs from the VAR_ENTRY list */
#define VAR_ENTRY(ID, VAR, NAME) ID,
typedef enum {
    #include VAR_LIST_INCLUDE
    VAR_COUNT
} var_id;
#undef VAR_ENTRY

extern var_entry var_registry[VAR_COUNT];

static inline var_entry *registry_get(var_id id) {
    if ((int)id < 0 || (int)id >= VAR_COUNT) return NULL;
    return &var_registry[id];
}

#endif // REGISTRY_H
```

## inc/variable_list_example.h
```c
/*
 * Example variable list format (for reference).
 * Each entry: VAR_ENTRY(ID, variable_symbol_name, "string_name")
 *
 * Example:
 * VAR_ENTRY(VAR_TEMP, temperature, "temp")
 * VAR_ENTRY(VAR_PRESS, pressure, "press")
 */

VAR_ENTRY(VAR_TEMP,  temperature, "temp")
VAR_ENTRY(VAR_PRESS, pressure,  "press")
VAR_ENTRY(VAR_HUM,   humidity,  "hum")
```

## src/command_parser.c
```c
#include "command_parser.h"
#include "registry.h"
#include <stdio.h>
#include <string.h>
#include <ctype.h>

/* ---------------- COMMAND LOOKUP TABLE ---------------- */
static command_process_fn command_handlers[] = {
    get_variable_names,
    get_variable,
    set_variable
};

static const char *command_strings[] = {
    "get_variable_names",
    "get_variable",
    "set_variable"
};

#define CMD_COUNT (sizeof(command_strings) / sizeof(command_strings[0]))

/* ---------------- GENERIC PARSER ---------------- */
void command_parser_process_data(struct telemetry_comm_interface *comm_interface,
                                 const char *data, size_t len)
{
    for (size_t i = 0; i < CMD_COUNT; i++) {
        size_t cmd_len = strlen(command_strings[i]);
        if (len >= cmd_len && strncmp(data, command_strings[i], cmd_len) == 0) {
            /* Expect parentheses */
            const char *args_start = data + cmd_len;
            while (*args_start == ' ') args_start++;

            if (*args_start != '(') {
                comm_interface->send(comm_interface->dev,
                                     "ERR:INVALID_FORMAT\n",
                                     strlen("ERR:INVALID_FORMAT\n"));
                return;
            }
            args_start++; // skip '('

            /* Find closing parenthesis */
            const char *args_end = strchr(args_start, ')');
            if (!args_end) {
                comm_interface->send(comm_interface->dev,
                                     "ERR:INVALID_FORMAT\n",
                                     strlen("ERR:INVALID_FORMAT\n"));
                return;
            }

            size_t args_len = args_end - args_start;
            command_handlers[i](comm_interface, args_start, args_len);
            return;
        }
    }

    comm_interface->send(comm_interface->dev,
                         "ERR:UNKNOWN_COMMAND\n",
                         strlen("ERR:UNKNOWN_COMMAND\n"));
}

/* ---------------- COMMAND IMPLEMENTATIONS ---------------- */
void get_variable_names(struct telemetry_comm_interface *comm_interface,
                        const char *data, size_t len)
{
    (void)data; (void)len;
    char response[512];
    size_t pos = 0;

    for (int i = 0; i < VAR_COUNT; i++) {
        var_entry *v = registry_get((var_id)i);
        if (!v) continue;

        pos += snprintf(response + pos, sizeof(response) - pos,
                        "%d:%s;", i, v->name);

        if (pos >= sizeof(response) - 16)
            break;
    }

    if (pos == 0) {
        comm_interface->send(comm_interface->dev,
                             "ERR:NO_VARIABLES\n",
                             strlen("ERR:NO_VARIABLES\n"));
        return;
    }

    // response[pos++] = '\n';
    comm_interface->send(comm_interface->dev, response, pos);
}

void get_variable(struct telemetry_comm_interface *comm_interface,
                  const char *data, size_t len)
{
    int index;
    if (sscanf(data, "%d", &index) != 1) {
        comm_interface->send(comm_interface->dev,
                             "ERR:INVALID_ARGUMENT\n",
                             strlen("ERR:INVALID_ARGUMENT\n"));
        return;
    }

    var_entry *v = registry_get((var_id)index);

    if (v == NULL) {
        comm_interface->send(comm_interface->dev,
                             "ERR:VARIABLE_NOT_FOUND\n",
                             strlen("ERR:VARIABLE_NOT_FOUND\n"));
        return;
    }

    char response[128];
    int len_out = snprintf(response, sizeof(response), "OK;%s:%g\n",
                           v->name, (double)*v->ptr);

    comm_interface->send(comm_interface->dev, response, len_out);
}

void set_variable(struct telemetry_comm_interface *comm_interface,
                  const char *data, size_t len)
{
    const char *ptr = data;
    int id;
    float value;
    int success_count = 0;

    while (sscanf(ptr, "%d:%f", &id, &value) == 2) {
        if (id < 0 || id >= VAR_COUNT) {
            comm_interface->send(comm_interface->dev,
                                 "ERR:INVALID_INDEX\n",
                                 strlen("ERR:INVALID_INDEX\n"));
            return;
        }

        var_entry *v = registry_get((var_id)id);
        if (!v) {
            comm_interface->send(comm_interface->dev,
                                 "ERR:VARIABLE_NOT_FOUND\n",
                                 strlen("ERR:VARIABLE_NOT_FOUND\n"));
            return;
        }

        *(v->ptr) = value;
        success_count++;

        const char *next = strchr(ptr, ';');
        if (!next) break;
        ptr = next + 1;
    }

    if (success_count == 0) {
        comm_interface->send(comm_interface->dev,
                             "ERR:INVALID_ARGUMENTS\n",
                             strlen("ERR:INVALID_ARGUMENTS\n"));
        return;
    }

    comm_interface->send(comm_interface->dev,
                         "OK\n",
                         strlen("OK\n"));
}
```

## src/command_processor.c
```c
#include "command_processor.h"
#include <string.h>

struct command_msg {
    struct telemetry_comm_interface *comm_interface;
    size_t len;
    char buf[CMD_MAX_LEN];
};

K_MSGQ_DEFINE(cmd_msgq, sizeof(struct command_msg), CMD_QUEUE_LEN, 4);

static struct k_work cmd_work;

static void cmd_work_handler(struct k_work *work)
{
    struct command_msg msg;

    while (k_msgq_get(&cmd_msgq, &msg, K_NO_WAIT) == 0) {
        command_parser_process_data(
            msg.comm_interface,
            msg.buf,
            msg.len
        );
    }
}


void command_processor_init(void)
{
    k_work_init(&cmd_work, cmd_work_handler);
}

void command_processor_submit(struct telemetry_comm_interface *iface,
                              const char *cmd,
                              size_t len)
{
    struct command_msg msg = {0};

    msg.comm_interface = iface;
    msg.len = len;
    memcpy(msg.buf, cmd, MIN(len, CMD_MAX_LEN - 1));

    k_msgq_put(&cmd_msgq, &msg, K_NO_WAIT);

    /* Schedule worker */
    k_work_submit(&cmd_work);
}
```

## src/registry.c
```c
#include "registry.h"

/* Declare externs */
#define VAR_ENTRY(ID, VAR, NAME) extern float VAR;
#include VAR_LIST_INCLUDE
#undef VAR_ENTRY

/* Construct the registry array */
#define VAR_ENTRY(ID, VAR, NAME) { NAME, &VAR },
var_entry var_registry[VAR_COUNT] = {
    #include VAR_LIST_INCLUDE
};
#undef VAR_ENTRY
```

## src/telemetry.c
```c
#include "registry.h"
#include "communication_interface.h"
#include <stdio.h>
#include <string.h>

struct registered_telemetry_senders_t registered_telemetry_senders;

#if !defined(CONFIG_TELEMETRY_ENABLE) || (CONFIG_TELEMETRY_ENABLE == 0)
#warning "Telemetry disabled by config"
#endif

#define TELEMETRY_INTERVAL_MS CONFIG_TELEMETRY_INTERVAL_MS

static inline void send_messages_over_senders(const char* message, size_t len) {
    for(size_t i = 0; i < registered_telemetry_senders.count; i++) {
        const struct telemetry_comm_interface* iface = registered_telemetry_senders.interfaces[i];
        iface->send(iface->dev, message, len);
    }
}

void telemetry_sender_task(void *a, void *b, void *c) {
    (void)a; (void)b; (void)c;
    char line[512] = {'\0'};
    while (1) {
        size_t pos = 0;
        for (int i = 0; i < VAR_COUNT; i++) {
            var_entry *v = registry_get((var_id)i);
            pos += snprintf(line + pos, sizeof(line) - pos, "%s:%g;", v->name, (double)*v->ptr);
            if (pos >= sizeof(line) - 32) break;
        }
        if (pos > 0) {
            line[pos++] = '\n';
            send_messages_over_senders(line, pos);
        }
        k_msleep(TELEMETRY_INTERVAL_MS);
    }
}

// K_THREAD_DEFINE(telemetry_sender_tid, 1024, telemetry_sender_task, NULL, NULL, NULL, 5, 0, 0);
```

## src/uart_communication.c
```c
#include "communication_interface.h"
#include <zephyr/sys/printk.h>
#include <zephyr/drivers/uart.h>
#include <zephyr/kernel.h>

static struct {
    char buffer[128];
    size_t index;
} rx_data;

static void uart_receive_callback(const struct device *dev, void *user_data)
{
    char c;
    while (uart_poll_in(dev, (unsigned char *)&c) == 0) {
        if (rx_data.index < sizeof(rx_data.buffer) - 1) {
            rx_data.buffer[rx_data.index++] = c;
            if (c == '\n') {
                rx_data.buffer[rx_data.index] = '\0'; // Null-terminate
                rx_data.index = 0; // Reset for next line
                /** Handle command, for now print*/
                printk("Received: %s", rx_data.buffer);
            }
        } else {
            // Buffer overflow, reset index
            rx_data.index = 0;
        }
    }
}

static void uart_send_data(const struct device *dev, const char *data, size_t len)
{
    (void)dev; // Unused parameter
    (void)len; // Unused parameter
    printk("%s", data);
}

struct telemetry_comm_interface uart_comm_interface = {
    .recv = uart_receive_callback,
    .send = uart_send_data,
};

struct telemetry_comm_interface *get_uart_comm_interface(void)
{
    return &uart_comm_interface;
}
```
